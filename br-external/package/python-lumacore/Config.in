## br-external/package/python-lumacore/Config.in
```kconfig
config BR2_PACKAGE_PYTHON_LUMACORE
	bool "python-lumacore"
	help
	  testests

	  https://github.com/rm-hull/luma.core
```

## br-external/package/python3/Config.in
```kconfig
        source "package/python-smbus2/Config.in"
        source "package/python-lumaoled/Config.in"
        source "package/python-lumacore/Config.in"
```
